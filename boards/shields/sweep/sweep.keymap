// Copyright (c) 2022 The ZMK Contributors
// SPDX-License-Identifier: MIT

#include <behaviors.dtsi>
#include <dt-bindings/zmk/keys.h>
#include <dt-bindings/zmk/bt.h>
#include <dt-bindings/zmk/ext_power.h>

#include "unicode.h"
#include "keycode_japanese.h"


#define DEF 0
#define LWR 1
#define RSE 2
#define ADJ 3

/ {
    behaviors {
        ht: hold_tap {
            compatible = "zmk,behavior-hold-tap";
            #binding-cells = <2>;
            flavor = "tap-preferred";
            tapping-term-ms = <220>;
            quick-tap-ms = <150>;
            require-prior-idle-ms = <100>;
            bindings = <&kp>, <&kp>;
        };
    };

    conditional_layers {
        compatible = "zmk,conditional-layers";
        tri_layer {
            if-layers = <1 2>;
            then-layer = <3>;
        };
    };

    keymap {
        compatible = "zmk,keymap";
        Base_Layer {
            
            bindings = <
&lt 3 ESCAPE      &kp Q         &kp W         &kp E         &kp R        &kp T        &kp Y  &kp U                &kp I      &kp O     &kp P        &kp BACKSPACE
&kp LEFT_CONTROL  &kp A         &kp S         &kp D         &kp F        &kp G        &kp H  &kp J                &kp K      &kp L     &kp MINUS    &mt RIGHT_CONTROL RETURN
&kp LEFT_SHIFT    &kp Z         &kp X         &kp C         &kp V        &kp B        &kp N  &kp M                &kp COMMA  &kp DOT   &kp RIGHT_SHIFT
&kp TAB           &kp LEFT_GUI  &lt 1 C_MENU  &kp LEFT_ALT  &lt 2 LANG2  &kp SPACE    &mo 1  &lt 2 LANG1  &kp LEFT   &kp DOWN  &kp UP       &kp RIGHT
            >;
        };

        Icon_Layer {
            
            bindings = <
&none            &kp N1    &kp N2    &kp N3     &kp N4  &kp N5     &kp N6     &kp N7    &kp N8    &kp N9         &kp N0       &kp DEL
&mt LCTRL K_APP  &none     &kp UP    &none      &none   &none      &kp CARET  &kp BSLH  &kp SEMI  &kp COLON      &kp AT       &kp LBKT
&kp LEFT_SHIFT   &kp LEFT  &kp DOWN  &kp RIGHT  &none   &numdot    &trans     &trans    &trans    &trans         &kp UNDER    &kp RBKT
&trans           &trans    &trans    &none      &trans  &trans     &trans     &trans    &kp HOME  &kp PAGE_DOWN  &kp PAGE_UP  &kp END
            >;
        };

        Num_Layer {
           
            bindings = <
&kp KP_NUMLOCK  &none            &kp KP_NUMBER_7  &kp KP_NUMBER_8  &kp KP_NUMBER_9  &kp MINUS    &kp MINUS        &kp KP_NUMBER_7  &kp KP_NUMBER_8  &kp KP_NUMBER_9  &kp MINUS  &bootloader
&kp CAPSLOCK    &kp DOT          &kp KP_NUMBER_4  &kp KP_NUMBER_5  &kp KP_NUMBER_6  &kp PLUS     &kp PLUS         &kp KP_NUMBER_4  &kp KP_NUMBER_5  &kp KP_NUMBER_6  &kp PLUS   &none
&none           &kp KP_NUMBER_0  &kp KP_NUMBER_1  &kp KP_NUMBER_2  &kp KP_NUMBER_3  &none        &none            &kp KP_NUMBER_1  &kp KP_NUMBER_2  &kp KP_NUMBER_3  &trans     &none
&trans          &none            &trans           &kp DOT          &none            &trans       &kp KP_NUMBER_0  &kp KP_NUMBER_0  &kp N0           &kp DOT          &none      &trans
            >;
        };

        Fn_Layer {
            bindings = <
&none       &kp F1        &kp F2        &kp F3        &kp F4  &kp F5     &kp F6        &none         &none         &none         &none         &bootloader
&none       &kp F6        &kp F7        &kp F8        &kp F9  &kp F10    &bt BT_SEL 4  &bt BT_SEL 3  &bt BT_SEL 2  &bt BT_SEL 1  &bt BT_SEL 0  &bt BT_CLR
&none       &kp F11       &kp F12       &none         &none   &none      &none         &none         &none         &none         &none         &ext_power EP_OFF
&bt BT_CLR  &bt BT_SEL 0  &bt BT_SEL 1  &bt BT_SEL 2  &none   &trans     &trans        &none         &trans        &trans        &none         &trans
            >;
        };
    };
};


        Icon_Layer {
            
            bindings = <
&none            &kp N1    &kp N2    &kp N3     &kp N4  &kp N5     &kp N6     &kp N7    &kp N8    &kp N9         &kp N0       &kp DEL
&mt LCTRL K_APP  &none     &kp UP    &none      &none   &none      &kp CARET  &kp BSLH  &kp SEMI  &kp COLON      &kp AT       &kp LBKT
&kp LEFT_SHIFT   &kp LEFT  &kp DOWN  &kp RIGHT  &none   &numdot    &trans     &trans    &trans    &trans         &kp UNDER    &kp RBKT
&trans           &trans    &trans    &none      &trans  &trans     &trans     &trans    &kp HOME  &kp PAGE_DOWN  &kp PAGE_UP  &kp END
            >;
        };
